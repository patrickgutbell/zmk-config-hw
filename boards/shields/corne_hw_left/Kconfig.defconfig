## boards/shields/corne_hw_left/Kconfig.defconfig
```kconfig
if SHIELD_CORNE_HW_LEFT

config ZMK_KEYBOARD_NAME
    default "Cornepat left"

config ZMK_SPLIT
	def_bool y

config ZMK_SPLIT_BLE
	def_bool y

config ZMK_SPLIT_ROLE_CENTRAL
	def_bool y

config ZMK_USB
	def_bool y

endif
```
