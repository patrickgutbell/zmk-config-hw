/*
 * Copyright (c) 2020 Pete Johanson
 *
 * SPDX-License-Identifier: MIT
 */

#include "cornepat.dtsi"

&kscan0 {  
                  /* Cols: P0.09, P0.10, P1.11, P1.13, P1.15, P0.02 */
        col-gpios = <&gpio0 2  GPIO_ACTIVE_HIGH>;
                    <&gpio1 15 GPIO_ACTIVE_HIGH>,
                    <&gpio1 13 GPIO_ACTIVE_HIGH>,
                    <&gpio1 11 GPIO_ACTIVE_HIGH>,
                    <&gpio0 10 GPIO_ACTIVE_HIGH>,
                    <&gpio0 9  GPIO_ACTIVE_HIGH>,
                    
};
